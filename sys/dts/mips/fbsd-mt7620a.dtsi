/* $FreeBSD: e88117b9e1f40848bf0acc55a7bebc6f4d35b819 $ */

&pcie {
	/*
	 * Our driver is different that OpenWRT's, so we need slightly
	 * different values for the reg property
	 */
	reg = <0x10140000 0x10000>;
};
